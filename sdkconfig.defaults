## sdkconfig.defaults
```kconfig
# -----------------------------------------------------------------------------
# ESP32-P4 chip revision compatibility defaults
# Target board: ESP32-P4 rev 1.x (e.g. v1.3)
# -----------------------------------------------------------------------------

#
# Chip revision
#
CONFIG_ESP32P4_SELECTS_REV_LESS_V3=y
# CONFIG_ESP32P4_REV_MIN_0 is not set
# CONFIG_ESP32P4_REV_MIN_1 is not set
CONFIG_ESP32P4_REV_MIN_100=y
CONFIG_ESP32P4_REV_MIN_FULL=100
CONFIG_ESP_REV_MIN_FULL=100
CONFIG_ESP32P4_REV_MAX_FULL=199
CONFIG_ESP_REV_MAX_FULL=199

#
# CPU frequency defaults
#
CONFIG_ESP_DEFAULT_CPU_FREQ_MHZ_360=y
# CONFIG_ESP_DEFAULT_CPU_FREQ_MHZ_400 is not set
CONFIG_ESP_DEFAULT_CPU_FREQ_MHZ=360

#
# Flash frequency defaults
#
CONFIG_ESPTOOLPY_FLASHFREQ_80M=y
# CONFIG_ESPTOOLPY_FLASHFREQ_40M is not set
# CONFIG_ESPTOOLPY_FLASHFREQ_20M is not set
CONFIG_ESPTOOLPY_FLASHFREQ_VAL=80
CONFIG_ESPTOOLPY_FLASHFREQ="80m"

#
# Flash size defaults (match detected 16MB SPI flash)
#
# CONFIG_ESPTOOLPY_FLASHSIZE_1MB is not set
# CONFIG_ESPTOOLPY_FLASHSIZE_2MB is not set
# CONFIG_ESPTOOLPY_FLASHSIZE_4MB is not set
# CONFIG_ESPTOOLPY_FLASHSIZE_8MB is not set
CONFIG_ESPTOOLPY_FLASHSIZE_16MB=y
# CONFIG_ESPTOOLPY_FLASHSIZE_32MB is not set
# CONFIG_ESPTOOLPY_FLASHSIZE_64MB is not set
# CONFIG_ESPTOOLPY_FLASHSIZE_128MB is not set
CONFIG_ESPTOOLPY_FLASHSIZE="16MB"

#
# Partition table defaults (use custom 16MiB layout file)
#
# CONFIG_PARTITION_TABLE_SINGLE_APP is not set
# CONFIG_PARTITION_TABLE_SINGLE_APP_LARGE is not set
# CONFIG_PARTITION_TABLE_TWO_OTA is not set
# CONFIG_PARTITION_TABLE_TWO_OTA_LARGE is not set
CONFIG_PARTITION_TABLE_CUSTOM=y
CONFIG_PARTITION_TABLE_CUSTOM_FILENAME="partitions-16MiB.csv"
CONFIG_PARTITION_TABLE_FILENAME="partitions-16MiB.csv"
CONFIG_PARTITION_TABLE_OFFSET=0x8000
CONFIG_PARTITION_TABLE_MD5=y

#
# Enable PSRAM for MIPI DSI frame buffer allocation
#
CONFIG_SPIRAM=y
CONFIG_SPIRAM_MODE_HEX=y
CONFIG_SPIRAM_SPEED_200M=y

#
# LVGL PPA / matrix rotation
#
CONFIG_LV_USE_PPA=y
CONFIG_LV_USE_PPA_IMG=y
CONFIG_LV_USE_MATRIX=y
CONFIG_LV_DRAW_TRANSFORM_USE_MATRIX=y
CONFIG_LV_DRAW_BUF_ALIGN=64

#
# Keep eFuse block revision range at project defaults
#
CONFIG_ESP_EFUSE_BLOCK_REV_MIN_FULL=0
CONFIG_ESP_EFUSE_BLOCK_REV_MAX_FULL=199
```
